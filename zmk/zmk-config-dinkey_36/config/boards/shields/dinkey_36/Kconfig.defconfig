## zmk/zmk-config-dinkey_36/config/boards/shields/dinkey_36/Kconfig.defconfig
```kconfig
# Copyright (c) 2021 The ZMK Contributors
# SPDX-License-Identifier: MIT

if SHIELD_DINKEY_36_LEFT

config ZMK_KEYBOARD_NAME
	default "Dinkey 36"

config ZMK_SPLIT_BLE_ROLE_CENTRAL
	default y

endif

if SHIELD_DINKEY_36_RIGHT

config ZMK_KEYBOARD_NAME
	default "Dinkey_36 Right"

endif

if SHIELD_DINKEY_36_LEFT || SHIELD_DINKEY_36_RIGHT

config ZMK_SPLIT
	default y

endif
```

## zmk/zmk-config-dinkey_36/config/boards/shields/dinkey_36/Kconfig.shield
```kconfig
# Copyright (c) 2021 The ZMK Contributors
# SPDX-License-Identifier: MIT

config SHIELD_DINKEY_36_LEFT
	def_bool $(shields_list_contains,dinkey_36_left)

config SHIELD_DINKEY_36_RIGHT
	def_bool $(shields_list_contains,dinkey_36_right)
```

## zmk/zmk-config-dinkey_42/config/boards/shields/dinkey_42/Kconfig.shield
```kconfig
# Copyright (c) 2021 The ZMK Contributors
# SPDX-License-Identifier: MIT

config SHIELD_DINKEY_42_LEFT
	def_bool $(shields_list_contains,dinkey_42_left)

config SHIELD_DINKEY_42_RIGHT
	def_bool $(shields_list_contains,dinkey_42_right)
```

## zmk/zmk-config-dinkey_52/config/boards/shields/dinkey_42/Kconfig.defconfig
```kconfig
# Copyright (c) 2021 The ZMK Contributors
# SPDX-License-Identifier: MIT

if SHIELD_DINKEY_52_LEFT

config ZMK_KEYBOARD_NAME
	default "Dinkey 52"

config ZMK_SPLIT_BLE_ROLE_CENTRAL
	default y

endif

if SHIELD_DINKEY_42_RIGHT

config ZMK_KEYBOARD_NAME
	default "Dinkey_52 Right"

endif

if SHIELD_DINKEY_52_LEFT || SHIELD_DINKEY_52_RIGHT

config ZMK_SPLIT
	default y

endif
```

## zmk/zmk-config-dinkey_52/config/boards/shields/dinkey_42/Kconfig.shield
```kconfig
# Copyright (c) 2021 The ZMK Contributors
# SPDX-License-Identifier: MIT

config SHIELD_DINKEY_52_LEFT
	def_bool $(shields_list_contains,dinkey_52_left)

config SHIELD_DINKEY_52_RIGHT
	def_bool $(shields_list_contains,dinkey_52_right)
```
